## drivers/input/misc/st/humidity/Kconfig
```kconfig
# SPDX-License-Identifier: GPL-2.0-only

menuconfig INPUT_HUMIDITY
	tristate "Humidity"

if INPUT_HUMIDITY

source "drivers/input/misc/st/humidity/hts221/Kconfig"

endif # INPUT_HUMIDITY
```

## drivers/input/misc/st/temperature/Kconfig
```kconfig
# SPDX-License-Identifier: GPL-2.0-only

menuconfig INPUT_TEMPERATURE
	tristate "Temperature"

if INPUT_TEMPERATURE

source "drivers/input/misc/st/temperature/stts751/Kconfig"
source "drivers/input/misc/st/temperature/stts22h/Kconfig"

endif # INPUT_TEMPERATURE
```

## drivers/input/misc/st/temperature/stts22h/Kconfig
```kconfig
# SPDX-License-Identifier: GPL-2.0-only

config INPUT_STTS22H
         tristate "STM STTS22H sensor"
         depends on I2C && SYSFS
         help
           This driver support the STMicroelectronics STTS22H temperature sensor.

	   To compile this driver as a module, choose M here. The module
	   will be called stts22h.
```

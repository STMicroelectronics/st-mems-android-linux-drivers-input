## Documentation/devicetree/bindings/input/st-ais2ih.txt
```
* ais2ih driver for imu MEMS sensors

Required properties for all bus drivers:
- compatible: must be one of:
              "st,ais2ih_input"

Optional properties for all bus drivers (more details reported in
Documentation/devicetree/bindings/interrupt-controller/interrupts.txt):
- interrupt-parent = This property is used to specify the controller to
                     which interrupts are routed.
- interrupts =       Interrupts listed here are always in reference to
                     the node's interrupt-parent.

Required properties for the i2c bindings:
- reg: i2c slave address

Required properties for the spi bindings:
- reg:               the chipselect index
- spi-max-frequency: maximal bus speed, should be set to 10000000 unless
                     constrained by external circuitry

Example for an spi device node:

ais2ih-input-acc@0 {
	compatible = "st,ais2ih_input";
	reg = <0x0>;
	spi-max-frequency = <10000000>;
};

Example for an i2c device node with pull down on SD0:

ais2ih-input-acc@18 {
	compatible = "st,ais2ih_input";
	reg = <0x18>;
};

Example for an i2c device node with pull up on SD0:

ais2ih-input-acc@19 {
	compatible = "st,ais2ih_input";
	reg = <0x19>;
};
```

## drivers/input/misc/st/acc/ais2dw12/Kconfig
```kconfig
config INPUT_AIS2DW12
	tristate "STMicroelectronics AIS2DW12 sensors"
	depends on (I2C || SPI) && SYSFS
	select INPUT_AIS2DW12_I2C if (I2C)
	select INPUT_AIS2DW12_SPI if (SPI)
	help
	   This driver support the STMicroelectronics AIS2DW12 sensors.

	   To compile this driver as a module, choose M here. The module
	   will be called ais2dw12.

config INPUT_AIS2DW12_I2C
	tristate
	depends on INPUT_AIS2DW12
	depends on I2C

config INPUT_AIS2DW12_SPI
	tristate
	depends on INPUT_AIS2DW12
	depends on SPI
```

## drivers/input/misc/st/acc/ais2ih/Kconfig
```kconfig
config INPUT_AIS2IH
	tristate "STMicroelectronics AIS2IH sensors"
	depends on (I2C || SPI) && SYSFS
	select INPUT_AIS2IH_I2C if (I2C)
	select INPUT_AIS2IH_SPI if (SPI)
	help
	   This driver support the STMicroelectronics AIS2IH sensors.

	   To compile this driver as a module, choose M here. The module
	   will be called ais2ih.

config INPUT_AIS2IH_I2C
	tristate
	depends on INPUT_AIS2IH
	depends on I2C

config INPUT_AIS2IH_SPI
	tristate
	depends on INPUT_AIS2IH
	depends on SPI
```

## stm_input_configs/accel_defconfig
```kconfig
# accelerometers
CONFIG_INPUT_ACC=y
CONFIG_INPUT_AIS2IH=m
CONFIG_INPUT_AIS2IH_I2C=m
CONFIG_INPUT_AIS2IH_SPI=m
CONFIG_INPUT_AIS328DQ=m
CONFIG_INPUT_AIS328DQ_I2C=m
CONFIG_INPUT_AIS328DQ_SPI=m
CONFIG_INPUT_AIS3624DQ=m
CONFIG_INPUT_AIS3624DQ_I2C=m
CONFIG_INPUT_AIS3624DQ_SPI=m
CONFIG_INPUT_LIS2DH=m
CONFIG_INPUT_LIS2DH_I2C=m
CONFIG_INPUT_LIS2DH_SPI=m
CONFIG_INPUT_LIS2DE=m
CONFIG_INPUT_LIS2DE_I2C=m
CONFIG_INPUT_LIS2DE_SPI=m
CONFIG_INPUT_LIS2DS=m
CONFIG_INPUT_LIS2DS_I2C=m
CONFIG_INPUT_LIS2DS_SPI=m
CONFIG_INPUT_H3LIS100DL=m
CONFIG_INPUT_H3LIS100DL_I2C=m
CONFIG_INPUT_H3LIS100DL_SPI=m
CONFIG_INPUT_LIS3DSH=m
CONFIG_INPUT_LIS3DSH_I2C=m
CONFIG_INPUT_LIS3DSH_SPI=m
CONFIG_INPUT_LIS2HH12=m
CONFIG_INPUT_LIS2HH12_I2C=m
CONFIG_INPUT_LIS2HH12_SPI=m
CONFIG_INPUT_LIS3DE=m
CONFIG_INPUT_LIS3DE_I2C=m
CONFIG_INPUT_LIS3DE_SPI=m
CONFIG_INPUT_LIS331DLH=m
CONFIG_INPUT_LIS331DLH_I2C=m
CONFIG_INPUT_LIS331DLH_SPI=m
CONFIG_INPUT_LIS331HH=m
CONFIG_INPUT_LIS331HH_I2C=m
CONFIG_INPUT_LIS331HH_SPI=m
CONFIG_INPUT_H3LIS331DL=m
CONFIG_INPUT_H3LIS331DL_I2C=m
CONFIG_INPUT_H3LIS331DL_SPI=m
CONFIG_INPUT_LIS3DH=m
CONFIG_INPUT_LIS3DH_I2C=m
CONFIG_INPUT_LIS3DH_SPI=m
CONFIG_INPUT_LIS2DW12=m
CONFIG_INPUT_LIS2DW12_I2C=m
CONFIG_INPUT_LIS2DW12_SPI=m
CONFIG_INPUT_LIS3DHH=m
CONFIG_INPUT_LIS3DHH_SPI=m
```

## stm_input_configs/environmental_defconfig
```kconfig
# Humidity
CONFIG_INPUT_HUMIDITY=y
CONFIG_INPUT_HTS221=m
CONFIG_INPUT_HTS221_I2C=m
CONFIG_INPUT_HTS221_SPI=m
# Pressure
CONFIG_INPUT_PRESSURE=y
CONFIG_INPUT_LPS22HB=m
CONFIG_INPUT_LPS22HB_I2C=m
CONFIG_INPUT_LPS22HB_SPI=m
CONFIG_INPUT_LPS25H=m
CONFIG_INPUT_LPS25H_I2C=m
CONFIG_INPUT_LPS25H_SPI=m
CONFIG_INPUT_LPS33HW=m
CONFIG_INPUT_LPS33HW_I2C=m
CONFIG_INPUT_LPS33HW_SPI=m
CONFIG_INPUT_LPS22HH=m
CONFIG_INPUT_LPS22HH_I2C=m
CONFIG_INPUT_LPS22HH_SPI=m
CONFIG_INPUT_LPS22DF=m
CONFIG_INPUT_LPS22DF_I2C=m
CONFIG_INPUT_LPS22DF_SPI=m
# Temperature
CONFIG_INPUT_TEMPERATURE=y
CONFIG_INPUT_STTS751=m
# UV
CONFIG_INPUT_UV=y
CONFIG_INPUT_UVIS25=m
CONFIG_INPUT_UVIS25_I2C=m
CONFIG_INPUT_UVIS25_SPI=m
```

## stm_input_configs/imus_defconfig
```kconfig
# IMUs
CONFIG_INPUT_IMU=y
CONFIG_INPUT_LSM6DS3=m
CONFIG_INPUT_LSM6DS3_I2C=m
CONFIG_INPUT_LSM6DS3_SPI=m
CONFIG_INPUT_LSM6DSM=m
CONFIG_INPUT_LSM6DSM_I2C=m
CONFIG_INPUT_LSM6DSM_SPI=m
CONFIG_INPUT_LSM6DSL=m
CONFIG_INPUT_LSM6DSL_I2C=m
CONFIG_INPUT_LSM6DSL_SPI=m
CONFIG_INPUT_LSM9DS0=m
CONFIG_INPUT_LSM9DS0_I2C=m
CONFIG_INPUT_LSM9DS0_SPI=m
CONFIG_INPUT_LSM9DS1=m
CONFIG_INPUT_LSM9DS1_I2C=m
CONFIG_INPUT_LSM9DS1_SPI=m
CONFIG_INPUT_LSM330DLC=m
CONFIG_INPUT_LSM330DLC_I2C=m
CONFIG_INPUT_LSM330DLC_SPI=m
CONFIG_INPUT_LSM6DS0=m
CONFIG_INPUT_LSM6DS0_I2C=m
CONFIG_INPUT_LSM6DS0_SPI=m
CONFIG_INPUT_LSM330=m
CONFIG_INPUT_LSM330_I2C=m
CONFIG_INPUT_LSM330_SPI=m
CONFIG_INPUT_ISM330DLC=m
CONFIG_INPUT_ISM330DLC_I2C=m
CONFIG_INPUT_ISM330DLC_SPI=m
CONFIG_INPUT_ASM330LHH=m
CONFIG_INPUT_ASM330LHH_I2C=m
CONFIG_INPUT_ASM330LHH_SPI=m
CONFIG_ASM330LHH_IRQ_THREAD=y
CONFIG_INPUT_LSM6DSOX=m
CONFIG_INPUT_LSM6DSOX_I2C=m
CONFIG_INPUT_LSM6DSOX_SPI=m
# e-compasses
CONFIG_INPUT_ECOMPASS=y
CONFIG_INPUT_LSM303AGR=m
CONFIG_INPUT_LSM303AGR_I2C=m
CONFIG_INPUT_LSM303AGR_SPI=m
CONFIG_INPUT_LSM303AH=m
CONFIG_INPUT_LSM303AH_I2C=m
CONFIG_INPUT_LSM303AH_SPI=m
CONFIG_INPUT_LSM303C=m
CONFIG_INPUT_LSM303C_I2C=m
CONFIG_INPUT_LSM303C_SPI=m
CONFIG_INPUT_LSM303D=m
CONFIG_INPUT_LSM303D_I2C=m
CONFIG_INPUT_LSM303D_SPI=m
CONFIG_INPUT_LSM303DLHC=m
CONFIG_INPUT_LSM303DLHC_I2C=m
CONFIG_INPUT_ISM303DAC=m
CONFIG_INPUT_ISM303DAC_I2C=m
CONFIG_INPUT_ISM303DAC_SPI=m
```

## stm_input_configs/magnetometer_gyroscope_defconfig
```kconfig
# gyroscopes
CONFIG_INPUT_GYRO=y
CONFIG_INPUT_L3G4200D=m
CONFIG_INPUT_L3G4200D_I2C=m
CONFIG_INPUT_L3G4200D_SPI=m
CONFIG_INPUT_L3GD20=m
CONFIG_INPUT_L3GD20_I2C=m
CONFIG_INPUT_L3GD20_SPI=m
CONFIG_INPUT_L3GD20H=m
CONFIG_INPUT_L3GD20H_I2C=m
CONFIG_INPUT_L3GD20H_SPI=m
CONFIG_INPUT_A3G4250D=m
CONFIG_INPUT_A3G4250D_I2C=m
CONFIG_INPUT_A3G4250D_SPI=m
# magnetometers
CONFIG_INPUT_MAGN=y
CONFIG_INPUT_LIS3MDL=m
CONFIG_INPUT_LIS3MDL_I2C=m
CONFIG_INPUT_LIS3MDL_SPI=m
CONFIG_INPUT_LIS2MDL=m
CONFIG_INPUT_LIS2MDL_I2C=m
CONFIG_INPUT_LIS2MDL_SPI=m
```
